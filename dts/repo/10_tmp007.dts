/dts-v1/;
/plugin/;

/ {
  compatible = "brcm,bcm2708"; /* probably will soon be bcm2835? */

  fragment@0 {
    target = <&i2c1>; /* NOTE: cannot use i2c_arm here! */
    __overlay__ {
      #address-cells = <1>; /* 1 for i2c devices */
      #size-cells = <0>;    /* 0 for i2c devices */
      status = "okay";

      tmp007: tmp007@44 {
        /* i2c */
        compatible = "ti,tmp007"; /* NOTE: in backports. This driver gives RAW values only. */
        reg = <0x44>; /* NOTE: pull any AD line up, or there will be a conflict with HTU21D! Pulling AD1 up gets you 0x44. */
        status = "okay";

        /* iio */
        #io-channel-cells = <1>; /* 1 for multiple channels */

        /* iio/magnetometer/tmp007 special config */
        /* (NONE) */
      };
    };
  };

  /* iio-hwmon bridge (modified version) */
  /* This mirrors iio channels to hwmon, which can be hooked to collectd. */
  fragment@1 {
    target-path = "/";
    __overlay__ {
      iio-hwmon-tmp007 {
        compatible = "iio-hwmon";
        io-channels = <&tmp007 0>, <&tmp007 1>;
        io-channel-names = "Ambient", "Object";
      };
    };
  };
};
