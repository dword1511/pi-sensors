/dts-v1/;
/plugin/;

/ {
  compatible = "brcm,bcm2708"; /* probably will soon be bcm2835? */

  /* i2c_arm */
  fragment@0 {
    target = <&i2c1>;
    __overlay__ {
      pinctrl-0 = <&i2c1_pins>;
      status = "okay";
    };
  };

  /* i2c_arm pins */
  fragment@1 {
    target = <&i2c1_pins>;
    pins: __overlay__ {
      brcm,pins = <2 3>;
      brcm,function = <4>; /* alt 0 */
    };
  };
};
