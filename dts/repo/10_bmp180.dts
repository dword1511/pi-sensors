/dts-v1/;
/plugin/;

/ {
  compatible = "brcm,bcm2708"; /* probably will soon be bcm2835? */

  fragment@0 {
    target = <&i2c1>; /* NOTE: cannot use i2c_arm here! */
    __overlay__ {
      #address-cells = <1>; /* 1 for i2c devices */
      #size-cells = <0>;    /* 0 for i2c devices */
      status = "okay";

      bmp180: bmp180@77 {
        /* i2c */
        compatible = "bosch,bmp180"; /* NOTE: load bmp280_i2c */
        reg = <0x77>;
        status = "okay";

        /* iio */
        #io-channel-cells = <1>; /* 1 for multiple channels */

        /* iio/pressure/bmp280 special config */
        temp-measurement-period = <500>;
        default-oversampling = <3>; /* NOTE: needs verification, documentation might be out-dated */
        /* TODO: should disable IRQ (only BMP085 has this but it has the same ID as BMP180.) */
      };
    };
  };

  /* iio-hwmon bridge (modified version) */
  /* This mirrors iio channels to hwmon, which can be hooked to collectd. */
  fragment@1 {
    target-path = "/";
    __overlay__ {
      iio-hwmon-bmp180 {
        compatible = "iio-hwmon";
        io-channels = <&bmp180 0>, <&bmp180 1>;
        io-channel-names = "Pressure kPa", "Ambient";
      };
    };
  };
};
