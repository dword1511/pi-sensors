/dts-v1/;
/plugin/;

/ {
  compatible = "brcm,bcm2708"; /* probably will soon be bcm2835? */

  fragment@0 {
    target = <&i2c1>; /* NOTE: cannot use i2c_arm here! */
    __overlay__ {
      #address-cells = <1>; /* 1 for i2c devices */
      #size-cells = <0>;    /* 0 for i2c devices */
      status = "okay";

      tsl2591: tsl2591@29 {
        /* i2c */
        compatible = "tsl2591"; /* NOTE: in backports */
        reg = <0x29>;
        status = "okay";

        /* iio */
        #io-channel-cells = <1>; /* 1 for multiple channels */

        /* iio/light/tsl2591 special config */
        /* (NONE) */
      };
    };
  };

  /* iio-hwmon bridge (modified version) */
  /* This mirrors iio channels to hwmon, which can be hooked to collectd. */
  fragment@1 {
    target-path = "/";
    __overlay__ {
      iio-hwmon-tsl2591 {
        compatible = "iio-hwmon";
        io-channels = <&tsl2591 0>, <&tsl2591 1>;
        io-channel-names = "Clear", "IR";
      };
    };
  };
};
