/dts-v1/;
/plugin/;

/ {
  compatible = "brcm,bcm2708"; /* probably will soon be bcm2835? */

  fragment@0 {
    target = <&i2c1>; /* NOTE: cannot use i2c_arm here! */
    __overlay__ {
      #address-cells = <1>; /* 1 for i2c devices */
      #size-cells = <0>;    /* 0 for i2c devices */
      status = "okay";

      htu21: htu21@40 {
        /* i2c */
        compatible = "htu21"; /* NOTE: will become "meas,htu21" in newer kernels */
        reg = <0x40>;
        status = "okay";

        /* iio */
        #io-channel-cells = <1>; /* 1 for multiple channels */

        /* iio/humidity/htu21 special config */
        /* (NONE) */
      };
    };
  };

  /* iio-hwmon bridge */
  /* NOTE: in-tree but not compiled */
  /* This mirrors iio channels to hwmon, which can be hooked to collectd. */
  fragment@1 {
    target-path = "/";
    __overlay__ {
      iio-hwmon-htu21 {
        compatible = "iio-hwmon";
        io-channels = <&htu21 0>, <&htu21 1>;
        io-channel-names = "Ambient", "Humidity";
      };
    };
  };
};
